## CMakeLists.txt
```
cmake_minimum_required(VERSION 3.20.0)

find_package(Zephyr REQUIRED HINTS $ENV{ZEPHYR_BASE})
project(contest_zephyr_control)

target_sources(app PRIVATE
  src/main.c
  src/icpc/icpc.c
  src/control_mailbox.c
  src/control_loop.c
  src/plant.c
  src/watchdog.c
)

zephyr_include_directories(include)
zephyr_include_directories(src)
```

## Kconfig
```
# SPDX-License-Identifier: Apache-2.0

mainmenu "TGOS contest Zephyr control guest"

source "$(ZEPHYR_BASE)/Kconfig"

config DUAL_BOOT_ID
	string "Contest dual-guest boot identifier"
	default "unknown"
	help
	  Boot identifier bound by the contest runner before build.

config CONTEST_NET_MODE
	string "Contest network mode"
	default "l3-smoke"
	help
	  P4 network mode selected at build time. Reliability images use
	  udp-reliability, tcp-reliability, or icpc-reliability.
```

## prj.conf
```kconfig
# Contest Zephyr control guest (P4 network skeleton, P5 plant/control).
# P4: low-priority network thread with l3-smoke / udp-echo / tcp-listen modes.

CONFIG_NETWORKING=y
CONFIG_NET_IPV4=y
CONFIG_NET_ARP=y
CONFIG_NET_UDP=y
CONFIG_NET_TCP=y
CONFIG_NET_NATIVE=y
CONFIG_ETH_VIRTIO_NET=y
CONFIG_NET_CONFIG_SETTINGS=y
CONFIG_NET_CONFIG_MY_IPV4_ADDR="10.77.0.2"
CONFIG_NET_CONFIG_MY_IPV4_NETMASK="255.255.255.0"
CONFIG_NET_CONFIG_PEER_IPV4_ADDR="10.77.0.1"
CONFIG_NET_CONFIG_INIT_PRIO=50

CONFIG_PRINTK=y
CONFIG_CONSOLE=y
CONFIG_UART_CONSOLE=y
CONFIG_BOOT_BANNER=y
CONFIG_MAIN_STACK_SIZE=4096
CONFIG_NUM_PREEMPT_PRIORITIES=8
CONFIG_ARMV8_A_NS=y

# P5 control skeleton options (kept minimal for P4).
CONFIG_DUAL_BOOT_ID="unknown"
CONFIG_NET_SOCKETS=y
CONFIG_POSIX_API=y
CONFIG_ENTROPY_GENERATOR=y
CONFIG_TEST_RANDOM_GENERATOR=y


# The board no longer selects NET_L2_ETHERNET (its e1000/PCIe path is
# disabled); the virtio-net driver needs it, so force it on here. ETH_DRIVER
# then defaults to y.
CONFIG_NET_L2_ETHERNET=y
```

## include/plant.h
```c
#ifndef CONTEST_ZEPHYR_CONTROL_PLANT_H
#define CONTEST_ZEPHYR_CONTROL_PLANT_H

#include <stdint.h>

#ifdef __cplusplus
extern "C" {
#endif

#define PLANT_TICK_PERIOD_MS UINT32_C(100)
#define PLANT_INITIAL_TEMPERATURE_MC INT32_C(25000)
#define PLANT_AMBIENT_TEMPERATURE_MC INT32_C(25000)
#define PLANT_TARGET_TEMPERATURE_MC INT32_C(55000)
#define PLANT_HEATER_RATE_MC_PER_SECOND INT32_C(4000)
#define PLANT_HEAT_LOSS_DIVISOR INT32_C(100)
#define PLANT_MIN_TEMPERATURE_MC INT32_C(-40000)
#define PLANT_MAX_TEMPERATURE_MC INT32_C(125000)
#define PLANT_DISTURBANCE_START_TICK UINT64_C(600)
#define PLANT_DISTURBANCE_END_TICK UINT64_C(899)
#define PLANT_DISTURBANCE_MC_PER_TICK INT32_C(-150)
#define PLANT_MIN_DUTY_Q16_16 INT32_C(0)
#define PLANT_MAX_DUTY_Q16_16 INT32_C(65536)

enum plant_status {
    PLANT_STATUS_OK = 0,
    PLANT_STATUS_NULL_ARGUMENT,
    PLANT_STATUS_INVALID_DUTY,
    PLANT_STATUS_RANGE_OVERFLOW,
    PLANT_STATUS_TICK_OVERFLOW,
    PLANT_STATUS_NONFINITE_PI,
};

struct plant_state {
    int32_t temperature_mC;
    uint64_t tick_index;
    int32_t duty_q16_16;
    uint8_t safe;
};

struct plant_step_result {
    enum plant_status status;
    int64_t candidate_temperature_mC;
    int32_t loss_mC;
    int32_t heater_mC;
    int32_t disturbance_mC;
};

struct plant_pi_controller {
    double integral_c_seconds;
};

/**
 * Reset a plant to the frozen qualification initial state.
 *
 * A null state is ignored so that a teardown path cannot turn a safety reset
 * into a host crash.
 */
void plant_reset(struct plant_state *state);

/**
 * Force the plant actuator to the safe value without changing temperature or
 * tick state.
 */
void plant_enter_safe(struct plant_state *state);

/**
 * Apply one validated duty at a period boundary.
 *
 * Invalid duty values fail closed by forcing duty zero and safe state. The
 * plant temperature and tick are not changed by a rejected duty.
 */
enum plant_status plant_apply_duty(struct plant_state *state,
                                   int32_t duty_q16_16);

/**
 * Advance the plant by one 100 ms tick using the duty selected at the period
 * boundary.
 *
 * The result is committed only when it is in the inclusive mC range
 * [-40000, 125000]. An out-of-range result leaves temperature and tick
 * unchanged, then forces duty zero and safe state.
 */
struct plant_step_result plant_step(struct plant_state *state);

/**
 * Reset the fixed binary64 PI controller integral to zero.
 */
void plant_pi_reset(struct plant_pi_controller *controller);

/**
 * Compute one fixed PI Q16.16 output using the frozen anti-windup rule.
 *
 * The controller uses the expression order from the P5 contract and rounds
 * non-negative output with floor(u * 65536 + 0.5).
 */
enum plant_status plant_pi_update(struct plant_pi_controller *controller,
                                  int32_t measured_mC, int32_t target_mC,
                                  int32_t *duty_q16_16);

#ifdef __cplusplus
}
#endif

#endif
```

## include/watchdog.h
```c
#ifndef CONTEST_ZEPHYR_CONTROL_WATCHDOG_H
#define CONTEST_ZEPHYR_CONTROL_WATCHDOG_H

#include <stdint.h>

#ifdef __cplusplus
extern "C" {
#endif

#define WATCHDOG_VALIDITY_MS UINT16_C(500)
#define WATCHDOG_TIMEOUT_MS UINT64_C(500)
#define WATCHDOG_TIMEOUT_NS UINT64_C(500000000)

enum watchdog_status {
    WATCHDOG_STATUS_ALIVE = 0,
    WATCHDOG_STATUS_SAFE,
    WATCHDOG_STATUS_EXPIRED,
    WATCHDOG_STATUS_NULL_ARGUMENT,
    WATCHDOG_STATUS_INVALID_SESSION,
    WATCHDOG_STATUS_NO_SESSION,
    WATCHDOG_STATUS_SESSION_MISMATCH,
    WATCHDOG_STATUS_SESSION_NOT_NEW,
    WATCHDOG_STATUS_INVALID_SEQUENCE,
    WATCHDOG_STATUS_INVALID_REQUEST,
    WATCHDOG_STATUS_INVALID_VALIDITY,
    WATCHDOG_STATUS_DUPLICATE,
    WATCHDOG_STATUS_STALE_SEQUENCE,
    WATCHDOG_STATUS_STALE_REQUEST,
    WATCHDOG_STATUS_AMBIGUOUS_ORDER,
    WATCHDOG_STATUS_RECOVERY_REQUIRES_SESSION,
    WATCHDOG_STATUS_CLOCK_BACKWARD,
};

struct watchdog {
    uint32_t active_session_id;
    uint32_t previous_session_id;
    uint32_t last_sequence;
    uint32_t last_request_id;
    uint64_t session_start_ns;
    uint64_t last_apply_ns;
    uint64_t last_observed_ns;
    uint8_t has_session;
    uint8_t has_previous_session;
    uint8_t has_apply;
    uint8_t has_observed_time;
    uint8_t safe_pending;
    uint8_t requires_new_session;
};

/**
 * Initialize a watchdog in safe state with no active session or valid output.
 */
void watchdog_init(struct watchdog *watchdog);

/**
 * Begin a locally-created session at a receiver monotonic timestamp.
 *
 * A new session starts safe and has no valid output deadline. The old session
 * cannot refresh this watchdog after the switch.
 */
enum watchdog_status watchdog_begin_session(struct watchdog *watchdog,
                                            uint32_t session_id,
                                            uint64_t now_ns);

/**
 * Accept one new, valid APPLY_OUTPUT and refresh the local 500 ms deadline.
 *
 * The timestamp is receiver-local monotonic time. Invalid validity, duplicate
 * identity, stale identity, wrong session, and backwards time do not refresh.
 */
enum watchdog_status watchdog_refresh_apply(struct watchdog *watchdog,
                                            uint32_t session_id,
                                            uint32_t sequence,
                                            uint32_t request_id,
                                            uint16_t validity_ms,
                                            uint64_t now_ns);

/**
 * Poll the watchdog at a local monotonic timestamp.
 *
 * Exactly 500 ms is expired. Once pending-safe, the state remains safe until
 * a newer valid APPLY_OUTPUT is accepted.
 */
enum watchdog_status watchdog_poll(struct watchdog *watchdog,
                                   uint64_t now_ns);

/**
 * Query the fail-closed pending-safe state. Null is considered safe.
 */
uint8_t watchdog_safe_pending(const struct watchdog *watchdog);

#ifdef __cplusplus
}
#endif

#endif
```

## src/control_mailbox.c
```c
#include <stddef.h>
#include "control_mailbox.h"

enum mailbox_order {
    MAILBOX_ORDER_OLDER = -1,
    MAILBOX_ORDER_SAME = 0,
    MAILBOX_ORDER_NEWER = 1,
    MAILBOX_ORDER_AMBIGUOUS = 2,
};

static enum control_mailbox_status validate_command(
    const struct control_mailbox_command *command);
static enum mailbox_order compare_sequence(uint32_t candidate,
                                            uint32_t current);
static enum control_mailbox_status compare_command_identity(
    const struct control_mailbox *mailbox,
    const struct control_mailbox_command *command);

void control_mailbox_init(struct control_mailbox *mailbox)
{
    if (mailbox == NULL) {
        return;
    }

    *mailbox = (struct control_mailbox){0};
}

enum control_mailbox_status
control_mailbox_begin_session(struct control_mailbox *mailbox,
                              uint32_t session_id)
{
    if (mailbox == NULL) {
        return CONTROL_MAILBOX_STATUS_NULL_ARGUMENT;
    }
    if (session_id == 0U) {
        return CONTROL_MAILBOX_STATUS_INVALID_SESSION;
    }
    if (mailbox->has_session && mailbox->active_session_id == session_id) {
        return CONTROL_MAILBOX_STATUS_SESSION_NOT_NEW;
    }
    if (mailbox->has_previous_session &&
        mailbox->previous_session_id == session_id) {
        return CONTROL_MAILBOX_STATUS_SESSION_NOT_NEW;
    }

    if (mailbox->has_session) {
        mailbox->previous_session_id = mailbox->active_session_id;
        mailbox->has_previous_session = UINT8_C(1);
    }
    mailbox->active_session_id = session_id;
    mailbox->has_session = UINT8_C(1);
    mailbox->has_order = UINT8_C(0);
    mailbox->has_pending = UINT8_C(0);
    mailbox->pending = (struct control_mailbox_command){0};
    mailbox->last_sequence = 0U;
    mailbox->last_request_id = 0U;
    return CONTROL_MAILBOX_STATUS_OK;
}

enum control_mailbox_status
control_mailbox_publish(struct control_mailbox *mailbox,
                        const struct control_mailbox_command *command)
{
    enum control_mailbox_status status;

    if (mailbox == NULL || command == NULL) {
        return CONTROL_MAILBOX_STATUS_NULL_ARGUMENT;
    }
    if (command->session_id == 0U) {
        return CONTROL_MAILBOX_STATUS_INVALID_SESSION;
    }
    if (!mailbox->has_session ||
        command->session_id != mailbox->active_session_id) {
        return CONTROL_MAILBOX_STATUS_SESSION_MISMATCH;
    }

    status = validate_command(command);
    if (status != CONTROL_MAILBOX_STATUS_OK) {
        return status;
    }
    if (mailbox->has_order) {
        status = compare_command_identity(mailbox, command);
        if (status != CONTROL_MAILBOX_STATUS_OK) {
            return status;
        }
    }

    mailbox->pending = *command;
    mailbox->has_pending = UINT8_C(1);
    mailbox->last_sequence = command->sequence;
    mailbox->last_request_id = command->request_id;
    mailbox->has_order = UINT8_C(1);
    return CONTROL_MAILBOX_STATUS_OK;
}

enum control_mailbox_status
control_mailbox_take(struct control_mailbox *mailbox,
                     struct control_mailbox_command *command)
{
    if (mailbox == NULL || command == NULL) {
        return CONTROL_MAILBOX_STATUS_NULL_ARGUMENT;
    }
    if (!mailbox->has_pending) {
        return CONTROL_MAILBOX_STATUS_EMPTY;
    }

    *command = mailbox->pending;
    mailbox->pending = (struct control_mailbox_command){0};
    mailbox->has_pending = UINT8_C(0);
    return CONTROL_MAILBOX_STATUS_OK;
}

uint8_t control_mailbox_has_pending(const struct control_mailbox *mailbox)
{
    if (mailbox == NULL) {
        return UINT8_C(0);
    }
    return mailbox->has_pending;
}

static enum control_mailbox_status validate_command(
    const struct control_mailbox_command *command)
{
    if (command->sequence == 0U) {
        return CONTROL_MAILBOX_STATUS_INVALID_SEQUENCE;
    }
    if (command->request_id == 0U) {
        return CONTROL_MAILBOX_STATUS_INVALID_REQUEST;
    }
    if (command->command < CONTROL_MAILBOX_APPLY_OUTPUT ||
        command->command > CONTROL_MAILBOX_SET_TARGET) {
        return CONTROL_MAILBOX_STATUS_INVALID_COMMAND;
    }
    if (command->control_mode > CONTROL_MAILBOX_MLP) {
        return CONTROL_MAILBOX_STATUS_INVALID_MODE;
    }
    if (command->target_mC != CONTROL_MAILBOX_TARGET_MC) {
        return CONTROL_MAILBOX_STATUS_INVALID_TARGET;
    }
    if (command->validity_ms != CONTROL_MAILBOX_VALIDITY_MS) {
        return CONTROL_MAILBOX_STATUS_INVALID_VALIDITY;
    }

    if (command->command == CONTROL_MAILBOX_APPLY_OUTPUT) {
        if (command->duty_q16_16 < CONTROL_MAILBOX_MIN_DUTY_Q16_16 ||
            command->duty_q16_16 > CONTROL_MAILBOX_MAX_DUTY_Q16_16) {
            return CONTROL_MAILBOX_STATUS_INVALID_DUTY;
        }
        if (command->control_mode == CONTROL_MAILBOX_MLP) {
            if (command->model_version == 0U) {
                return CONTROL_MAILBOX_STATUS_INVALID_MODEL_VERSION;
            }
        } else if (command->model_version != 0U) {
            return CONTROL_MAILBOX_STATUS_INVALID_MODEL_VERSION;
        }
        return CONTROL_MAILBOX_STATUS_OK;
    }

    if (command->duty_q16_16 != 0 || command->model_version != 0U) {
        return CONTROL_MAILBOX_STATUS_INVALID_DUTY;
    }
    return CONTROL_MAILBOX_STATUS_OK;
}

static enum mailbox_order compare_sequence(uint32_t candidate,
                                            uint32_t current)
{
    const uint32_t difference = candidate - current;

    if (difference == 0U) {
        return MAILBOX_ORDER_SAME;
    }
    if (difference == UINT32_C(0x80000000)) {
        return MAILBOX_ORDER_AMBIGUOUS;
    }
    if (difference < UINT32_C(0x80000000)) {
        return MAILBOX_ORDER_NEWER;
    }
    return MAILBOX_ORDER_OLDER;
}

static enum control_mailbox_status compare_command_identity(
    const struct control_mailbox *mailbox,
    const struct control_mailbox_command *command)
{
    const enum mailbox_order sequence_order =
        compare_sequence(command->sequence, mailbox->last_sequence);
    const enum mailbox_order request_order =
        compare_sequence(command->request_id, mailbox->last_request_id);

    if (sequence_order == MAILBOX_ORDER_AMBIGUOUS ||
        request_order == MAILBOX_ORDER_AMBIGUOUS) {
        return CONTROL_MAILBOX_STATUS_AMBIGUOUS_ORDER;
    }
    if (sequence_order == MAILBOX_ORDER_SAME &&
        request_order == MAILBOX_ORDER_SAME) {
        return CONTROL_MAILBOX_STATUS_DUPLICATE;
    }
    if (sequence_order != MAILBOX_ORDER_NEWER) {
        return CONTROL_MAILBOX_STATUS_STALE_SEQUENCE;
    }
    if (request_order != MAILBOX_ORDER_NEWER) {
        return CONTROL_MAILBOX_STATUS_STALE_REQUEST;
    }
    return CONTROL_MAILBOX_STATUS_OK;
}
```

## src/plant.c
```c
#include <stddef.h>
#include "plant.h"

#include <math.h>

static int valid_duty(int32_t duty_q16_16);
static int64_t plant_loss(int32_t temperature_mC);
static int64_t plant_heater(int32_t duty_q16_16);
static int64_t plant_disturbance(uint64_t tick_index);
static double clamp_integral(double integral_c_seconds);
static double fixed_pi_output(double error_c, double integral_c_seconds);
static int32_t quantize_pi_output(double output);

void plant_reset(struct plant_state *state)
{
    if (state == NULL) {
        return;
    }

    state->temperature_mC = PLANT_INITIAL_TEMPERATURE_MC;
    state->tick_index = 0U;
    state->duty_q16_16 = PLANT_MIN_DUTY_Q16_16;
    state->safe = UINT8_C(1);
}

void plant_enter_safe(struct plant_state *state)
{
    if (state == NULL) {
        return;
    }

    state->duty_q16_16 = PLANT_MIN_DUTY_Q16_16;
    state->safe = UINT8_C(1);
}

enum plant_status plant_apply_duty(struct plant_state *state,
                                   int32_t duty_q16_16)
{
    if (state == NULL) {
        return PLANT_STATUS_NULL_ARGUMENT;
    }
    if (!valid_duty(duty_q16_16)) {
        plant_enter_safe(state);
        return PLANT_STATUS_INVALID_DUTY;
    }

    state->duty_q16_16 = duty_q16_16;
    state->safe = UINT8_C(0);
    return PLANT_STATUS_OK;
}

struct plant_step_result plant_step(struct plant_state *state)
{
    struct plant_step_result result = {
        .status = PLANT_STATUS_OK,
        .candidate_temperature_mC = 0,
        .loss_mC = 0,
        .heater_mC = 0,
        .disturbance_mC = 0,
    };
    int64_t next_temperature_mC;

    if (state == NULL) {
        result.status = PLANT_STATUS_NULL_ARGUMENT;
        return result;
    }
    if (!valid_duty(state->duty_q16_16)) {
        plant_enter_safe(state);
        result.status = PLANT_STATUS_INVALID_DUTY;
        return result;
    }
    if (state->temperature_mC < PLANT_MIN_TEMPERATURE_MC ||
        state->temperature_mC > PLANT_MAX_TEMPERATURE_MC) {
        plant_enter_safe(state);
        result.status = PLANT_STATUS_RANGE_OVERFLOW;
        result.candidate_temperature_mC = state->temperature_mC;
        return result;
    }
    if (state->tick_index == UINT64_MAX) {
        plant_enter_safe(state);
        result.status = PLANT_STATUS_TICK_OVERFLOW;
        result.candidate_temperature_mC = state->temperature_mC;
        return result;
    }

    /* C99 signed division deliberately supplies truncation toward zero. */
    result.loss_mC = (int32_t)plant_loss(state->temperature_mC);
    result.heater_mC = (int32_t)plant_heater(state->duty_q16_16);
    result.disturbance_mC = (int32_t)plant_disturbance(state->tick_index);
    next_temperature_mC = (int64_t)state->temperature_mC +
                          (int64_t)result.loss_mC +
                          (int64_t)result.heater_mC +
                          (int64_t)result.disturbance_mC;
    result.candidate_temperature_mC = next_temperature_mC;

    if (next_temperature_mC < PLANT_MIN_TEMPERATURE_MC ||
        next_temperature_mC > PLANT_MAX_TEMPERATURE_MC) {
        plant_enter_safe(state);
        result.status = PLANT_STATUS_RANGE_OVERFLOW;
        return result;
    }

    state->temperature_mC = (int32_t)next_temperature_mC;
    state->tick_index += UINT64_C(1);
    return result;
}

void plant_pi_reset(struct plant_pi_controller *controller)
{
    if (controller == NULL) {
        return;
    }

    controller->integral_c_seconds = 0.0;
}

enum plant_status plant_pi_update(struct plant_pi_controller *controller,
                                  int32_t measured_mC, int32_t target_mC,
                                  int32_t *duty_q16_16)
{
    double error_c;
    double previous_integral;
    double candidate_integral;
    double candidate_output;
    double output;

    if (controller == NULL || duty_q16_16 == NULL) {
        return PLANT_STATUS_NULL_ARGUMENT;
    }

    previous_integral = controller->integral_c_seconds;
    if (!isfinite(previous_integral)) {
        return PLANT_STATUS_NONFINITE_PI;
    }

    error_c = ((double)target_mC - (double)measured_mC) / 1000.0;
    candidate_integral = clamp_integral(previous_integral + 0.1 * error_c);
    candidate_output = fixed_pi_output(error_c, candidate_integral);

    if ((candidate_output > 1.0 && error_c > 0.0) ||
        (candidate_output < 0.0 && error_c < 0.0)) {
        controller->integral_c_seconds = previous_integral;
        output = fixed_pi_output(error_c, previous_integral);
    } else {
        controller->integral_c_seconds = candidate_integral;
        output = candidate_output;
    }

    if (!isfinite(output)) {
        return PLANT_STATUS_NONFINITE_PI;
    }
    if (output < 0.0) {
        output = 0.0;
    } else if (output > 1.0) {
        output = 1.0;
    }
    *duty_q16_16 = quantize_pi_output(output);
    return PLANT_STATUS_OK;
}

static int valid_duty(int32_t duty_q16_16)
{
    return duty_q16_16 >= PLANT_MIN_DUTY_Q16_16 &&
           duty_q16_16 <= PLANT_MAX_DUTY_Q16_16;
}

static int64_t plant_loss(int32_t temperature_mC)
{
    const int64_t numerator = (int64_t)PLANT_AMBIENT_TEMPERATURE_MC -
                              (int64_t)temperature_mC;

    return numerator / PLANT_HEAT_LOSS_DIVISOR;
}

static int64_t plant_heater(int32_t duty_q16_16)
{
    const int64_t numerator = (int64_t)PLANT_HEATER_RATE_MC_PER_SECOND / 10 *
                              (int64_t)duty_q16_16 +
                              INT64_C(32768);

    return numerator / INT64_C(65536);
}

static int64_t plant_disturbance(uint64_t tick_index)
{
    if (tick_index >= PLANT_DISTURBANCE_START_TICK &&
        tick_index <= PLANT_DISTURBANCE_END_TICK) {
        return PLANT_DISTURBANCE_MC_PER_TICK;
    }
    return 0;
}

static double clamp_integral(double integral_c_seconds)
{
    if (integral_c_seconds < -100.0) {
        return -100.0;
    }
    if (integral_c_seconds > 100.0) {
        return 100.0;
    }
    return integral_c_seconds;
}

static double fixed_pi_output(double error_c, double integral_c_seconds)
{
    const double proportional_term = 0.025 * error_c;
    const double integral_term = 0.005 * integral_c_seconds;

    return proportional_term + integral_term;
}

static int32_t quantize_pi_output(double output)
{
    if (output <= 0.0) {
        return PLANT_MIN_DUTY_Q16_16;
    }
    if (output >= 1.0) {
        return PLANT_MAX_DUTY_Q16_16;
    }
    return (int32_t)(output * 65536.0 + 0.5);
}
```

## src/watchdog.c
```c
#include <stddef.h>
#include "watchdog.h"

enum watchdog_order {
    WATCHDOG_ORDER_OLDER = -1,
    WATCHDOG_ORDER_SAME = 0,
    WATCHDOG_ORDER_NEWER = 1,
    WATCHDOG_ORDER_AMBIGUOUS = 2,
};

static enum watchdog_status observe_time(struct watchdog *watchdog,
                                         uint64_t now_ns);
static enum watchdog_order compare_sequence(uint32_t candidate,
                                             uint32_t current);
static enum watchdog_status compare_identity(const struct watchdog *watchdog,
                                             uint32_t sequence,
                                             uint32_t request_id);

void watchdog_init(struct watchdog *watchdog)
{
    if (watchdog == NULL) {
        return;
    }

    *watchdog = (struct watchdog){0};
    watchdog->safe_pending = UINT8_C(1);
}

enum watchdog_status watchdog_begin_session(struct watchdog *watchdog,
                                            uint32_t session_id,
                                            uint64_t now_ns)
{
    enum watchdog_status time_status;

    if (watchdog == NULL) {
        return WATCHDOG_STATUS_NULL_ARGUMENT;
    }
    if (session_id == 0U) {
        return WATCHDOG_STATUS_INVALID_SESSION;
    }
    time_status = observe_time(watchdog, now_ns);
    if (time_status != WATCHDOG_STATUS_ALIVE) {
        return time_status;
    }
    if (watchdog->has_session && watchdog->active_session_id == session_id) {
        return WATCHDOG_STATUS_SESSION_NOT_NEW;
    }
    if (watchdog->has_previous_session &&
        watchdog->previous_session_id == session_id) {
        return WATCHDOG_STATUS_SESSION_NOT_NEW;
    }

    if (watchdog->has_session) {
        watchdog->previous_session_id = watchdog->active_session_id;
        watchdog->has_previous_session = UINT8_C(1);
    }
    watchdog->active_session_id = session_id;
    watchdog->session_start_ns = now_ns;
    watchdog->last_apply_ns = 0U;
    watchdog->last_sequence = 0U;
    watchdog->last_request_id = 0U;
    watchdog->has_session = UINT8_C(1);
    watchdog->has_apply = UINT8_C(0);
    watchdog->safe_pending = UINT8_C(1);
    watchdog->requires_new_session = UINT8_C(0);
    return WATCHDOG_STATUS_ALIVE;
}

enum watchdog_status watchdog_refresh_apply(struct watchdog *watchdog,
                                            uint32_t session_id,
                                            uint32_t sequence,
                                            uint32_t request_id,
                                            uint16_t validity_ms,
                                            uint64_t now_ns)
{
    enum watchdog_status time_status;
    enum watchdog_status identity_status;

    if (watchdog == NULL) {
        return WATCHDOG_STATUS_NULL_ARGUMENT;
    }
    time_status = observe_time(watchdog, now_ns);
    if (time_status == WATCHDOG_STATUS_CLOCK_BACKWARD) {
        return time_status;
    }
    if (session_id == 0U) {
        return WATCHDOG_STATUS_INVALID_SESSION;
    }
    if (!watchdog->has_session) {
        return WATCHDOG_STATUS_NO_SESSION;
    }
    if (session_id != watchdog->active_session_id) {
        return WATCHDOG_STATUS_SESSION_MISMATCH;
    }
    if (sequence == 0U) {
        return WATCHDOG_STATUS_INVALID_SEQUENCE;
    }
    if (request_id == 0U) {
        return WATCHDOG_STATUS_INVALID_REQUEST;
    }
    if (validity_ms != WATCHDOG_VALIDITY_MS) {
        return WATCHDOG_STATUS_INVALID_VALIDITY;
    }
    if (watchdog->requires_new_session) {
        return WATCHDOG_STATUS_RECOVERY_REQUIRES_SESSION;
    }
    if (watchdog->has_apply) {
        identity_status = compare_identity(watchdog, sequence, request_id);
        if (identity_status != WATCHDOG_STATUS_ALIVE) {
            return identity_status;
        }
    }

    watchdog->last_sequence = sequence;
    watchdog->last_request_id = request_id;
    watchdog->last_apply_ns = now_ns;
    watchdog->has_apply = UINT8_C(1);
    watchdog->safe_pending = UINT8_C(0);
    watchdog->requires_new_session = UINT8_C(0);
    return WATCHDOG_STATUS_ALIVE;
}

enum watchdog_status watchdog_poll(struct watchdog *watchdog,
                                   uint64_t now_ns)
{
    enum watchdog_status time_status;

    if (watchdog == NULL) {
        return WATCHDOG_STATUS_NULL_ARGUMENT;
    }
    time_status = observe_time(watchdog, now_ns);
    if (time_status == WATCHDOG_STATUS_CLOCK_BACKWARD) {
        watchdog->safe_pending = UINT8_C(1);
        return time_status;
    }
    if (!watchdog->has_session || !watchdog->has_apply) {
        watchdog->safe_pending = UINT8_C(1);
        return WATCHDOG_STATUS_SAFE;
    }
    if (watchdog->safe_pending) {
        return WATCHDOG_STATUS_EXPIRED;
    }
    if (now_ns - watchdog->last_apply_ns >= WATCHDOG_TIMEOUT_NS) {
        watchdog->safe_pending = UINT8_C(1);
        watchdog->requires_new_session = UINT8_C(1);
        return WATCHDOG_STATUS_EXPIRED;
    }
    return WATCHDOG_STATUS_ALIVE;
}

uint8_t watchdog_safe_pending(const struct watchdog *watchdog)
{
    if (watchdog == NULL) {
        return UINT8_C(1);
    }
    return watchdog->safe_pending;
}

static enum watchdog_status observe_time(struct watchdog *watchdog,
                                         uint64_t now_ns)
{
    if (watchdog->has_observed_time && now_ns < watchdog->last_observed_ns) {
        watchdog->safe_pending = UINT8_C(1);
        if (watchdog->has_apply) {
            watchdog->requires_new_session = UINT8_C(1);
        }
        return WATCHDOG_STATUS_CLOCK_BACKWARD;
    }

    watchdog->last_observed_ns = now_ns;
    watchdog->has_observed_time = UINT8_C(1);
    return WATCHDOG_STATUS_ALIVE;
}

static enum watchdog_order compare_sequence(uint32_t candidate,
                                             uint32_t current)
{
    const uint32_t difference = candidate - current;

    if (difference == 0U) {
        return WATCHDOG_ORDER_SAME;
    }
    if (difference == UINT32_C(0x80000000)) {
        return WATCHDOG_ORDER_AMBIGUOUS;
    }
    if (difference < UINT32_C(0x80000000)) {
        return WATCHDOG_ORDER_NEWER;
    }
    return WATCHDOG_ORDER_OLDER;
}

static enum watchdog_status compare_identity(const struct watchdog *watchdog,
                                             uint32_t sequence,
                                             uint32_t request_id)
{
    const enum watchdog_order sequence_order =
        compare_sequence(sequence, watchdog->last_sequence);
    const enum watchdog_order request_order =
        compare_sequence(request_id, watchdog->last_request_id);

    if (sequence_order == WATCHDOG_ORDER_AMBIGUOUS ||
        request_order == WATCHDOG_ORDER_AMBIGUOUS) {
        return WATCHDOG_STATUS_AMBIGUOUS_ORDER;
    }
    if (sequence_order == WATCHDOG_ORDER_SAME &&
        request_order == WATCHDOG_ORDER_SAME) {
        return WATCHDOG_STATUS_DUPLICATE;
    }
    if (sequence_order != WATCHDOG_ORDER_NEWER) {
        return WATCHDOG_STATUS_STALE_SEQUENCE;
    }
    if (request_order != WATCHDOG_ORDER_NEWER) {
        return WATCHDOG_STATUS_STALE_REQUEST;
    }
    return WATCHDOG_STATUS_ALIVE;
}
```
