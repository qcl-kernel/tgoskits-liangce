## CMakeLists.txt
```
cmake_minimum_required(VERSION 3.20.0)

find_package(Zephyr REQUIRED HINTS $ENV{ZEPHYR_BASE})
project(contest_zephyr_control)

target_sources(app PRIVATE
  src/main.c
  src/icpc/icpc.c
  src/control_mailbox.c
  src/plant.c
  src/watchdog.c
)

zephyr_include_directories(include)
zephyr_include_directories(src)
```

## Kconfig
```
# SPDX-License-Identifier: Apache-2.0

mainmenu "TGOS contest Zephyr control guest"

source "$(ZEPHYR_BASE)/Kconfig"

config DUAL_BOOT_ID
	string "Contest dual-guest boot identifier"
	default "unknown"
	help
	  Boot identifier bound by the contest runner before build.

config CONTEST_NET_MODE
	string "Contest network mode (l3-smoke/udp-echo/tcp-listen)"
	default "l3-smoke"
	help
	  P4 network mode selected at build time.
```

## prj.conf
```kconfig
# Contest Zephyr control guest (P4 network skeleton, P5 plant/control).
# P4: low-priority network thread with l3-smoke / udp-echo / tcp-listen modes.

CONFIG_NETWORKING=y
CONFIG_NET_IPV4=y
CONFIG_NET_ARP=y
CONFIG_NET_UDP=y
CONFIG_NET_TCP=y
CONFIG_NET_NATIVE=y
CONFIG_ETH_VIRTIO_NET=y
CONFIG_NET_CONFIG_SETTINGS=y
CONFIG_NET_CONFIG_MY_IPV4_ADDR="10.77.0.2"
CONFIG_NET_CONFIG_MY_IPV4_NETMASK="255.255.255.0"
CONFIG_NET_CONFIG_PEER_IPV4_ADDR="10.77.0.1"
CONFIG_NET_CONFIG_INIT_PRIO=50

CONFIG_PRINTK=y
CONFIG_CONSOLE=y
CONFIG_UART_CONSOLE=y
CONFIG_BOOT_BANNER=y
CONFIG_MAIN_STACK_SIZE=4096
CONFIG_ARMV8_A_NS=y

# P5 control skeleton options (kept minimal for P4).
CONFIG_DUAL_BOOT_ID="unknown"
CONFIG_NET_SOCKETS=y
CONFIG_POSIX_API=y
CONFIG_ENTROPY_GENERATOR=y
CONFIG_TEST_RANDOM_GENERATOR=y


# The board no longer selects NET_L2_ETHERNET (its e1000/PCIe path is
# disabled); the virtio-net driver needs it, so force it on here. ETH_DRIVER
# then defaults to y.
CONFIG_NET_L2_ETHERNET=y

# P5-AI-Q (TEST-017): longer closed-loop runs need more net buffers; the
# default pool starved after ~30-40 s of sustained ACK/STATUS traffic and
# the netstack began dropping ACKs (observed per-tick stalls of 8 s).
CONFIG_NET_PKT_RX_COUNT=128
CONFIG_NET_PKT_TX_COUNT=64
CONFIG_NET_BUF_RX_COUNT=128
CONFIG_NET_BUF_TX_COUNT=64
CONFIG_NET_IF_UNICAST_IPV4_ADDR_COUNT=2
CONFIG_NET_MAX_CONTEXTS=16

# P5-AI-Q (TEST-017): keep the fixed peer in the ARP cache for the whole
# 180 s run.  With the default timeout the entry expired mid-run and the
# resulting ARP storm flooded the RX path (observed ~150 ARP frames and
# per-tick 8 s ACK stalls after ~70 s).
CONFIG_NET_ARP_TIMEOUT=3600
```

## src/main.c
```c
// Copyright 2025 The Axvisor Team
//
// Licensed under the Apache License, Version 2.0 (the "License");
// you may not use this file except in compliance with the License.
// You may obtain a copy of the License at
//
//     http://www.apache.org/licenses/LICENSE-2.0
//
// Unless required by applicable law or agreed to in writing, software
// distributed under the License is distributed on an "AS IS" BASIS,
// WITHOUT WARRANTIES OR CONDITIONS OF ANY KIND, either express or implied.
// See the License for the specific language governing permissions and
// limitations under the License.

/* Contest Zephyr control guest.
 *
 * P4: low-priority network thread with l3-smoke / udp-echo / tcp-listen
 * modes over the mediated virtio-net frontend.  P5 adds the plant/control
 * loop on top of the ICPC link.
 *
 * The READY marker binds the boot id and the actual interface identity
 * (MAC, IPv4, prefix, connected route, MTU).
 */

#include <zephyr/kernel.h>
#include <zephyr/net/net_if.h>
#include <zephyr/net/net_mgmt.h>
#include <zephyr/net/net_core.h>
#include <zephyr/net/net_ip.h>
#include <zephyr/net/socket.h>
#include <zephyr/posix/unistd.h>
#include <zephyr/posix/netdb.h>
#include <zephyr/sys/printk.h>

#include "icpc/icpc.h"
#include "plant.h"

#define PEER_IP "10.77.0.1"
#define UDP_PORT 46000
#define TCP_PORT 46001

#define NET_STACK_SIZE 4096
#define NET_PRIORITY 8

static void print_ready(void)
{
	struct net_if *iface = net_if_get_default();
	struct in_addr addr;
	char mac[18];
	uint8_t raw_mac[6];
	size_t mtu = 0;

	if (iface == NULL) {
		printk("AXVISOR_DUAL_GUEST_ZEPHYR_READY vm=2 boot_id=%s iface=none\n",
		       CONFIG_DUAL_BOOT_ID);
		return;
	}
	if (net_if_get_link_addr(iface)->len >= 6) {
		memcpy(raw_mac, net_if_get_link_addr(iface)->addr, 6);
		snprintk(mac, sizeof(mac), "%02x:%02x:%02x:%02x:%02x:%02x",
			 raw_mac[0], raw_mac[1], raw_mac[2],
			 raw_mac[3], raw_mac[4], raw_mac[5]);
	} else {
		strcpy(mac, "00:00:00:00:00:00");
	}
	if (net_if_get_mtu(iface) > 0) {
		mtu = net_if_get_mtu(iface);
	}
	/* The configured IPv4 address of the default interface. */
	(void)net_addr_pton(AF_INET, CONFIG_NET_CONFIG_MY_IPV4_ADDR, &addr);
	char ip[16] = "0.0.0.0";
	net_addr_ntop(AF_INET, &addr, ip, sizeof(ip));

	printk("AXVISOR_DUAL_GUEST_ZEPHYR_READY vm=2 boot_id=%s iface=%s mac=%s "
	       "ipv4=%s prefix=24 route=10.77.0.0/24 mtu=%zu\n",
	       CONFIG_DUAL_BOOT_ID, net_if_get_device(iface)->name, mac, ip, mtu);
}

static int udp_echo_thread(void)
{
	struct sockaddr_in local;
	struct sockaddr_in from;
	socklen_t from_len = sizeof(from);
	char buf[2048];
	int sock = zsock_socket(AF_INET, SOCK_DGRAM, IPPROTO_UDP);

	if (sock < 0) {
		printk("TGOS_ZEPHYR_NET_FAIL sock=%d\n", sock);
		return -1;
	}
	memset(&local, 0, sizeof(local));
	local.sin_family = AF_INET;
	local.sin_port = htons(UDP_PORT);
	if (zsock_bind(sock, (struct sockaddr *)&local, sizeof(local)) < 0) {
		printk("TGOS_ZEPHYR_NET_FAIL bind\n");
		return -1;
	}
	printk("TGOS_ZEPHYR_UDP_ECHO_READY port=%d\n", UDP_PORT);
	/* P5-AI-B: DEC-008 plant driving the real STATUS payload. */
	struct plant_state plant;
	plant_reset(&plant);
	/* P5-AI-Q (TEST-018): 500 ms watchdog.  The socket is polled every
	 * 100 ms (poll does not consume data and does not disturb the netstack
	 * like a short recvfrom timeout does); when no valid new CONTROL
	 * arrived for >= 500 ms the plant duty is forced to zero and
	 * SAFE|NETWORK_TIMEOUT is reported. Any new valid CONTROL resumes
	 * normal operation (new session/seq). */
	int64_t last_control_ms = k_uptime_get();
	struct zsock_pollfd pfd = {0};
	pfd.fd = sock;
	pfd.events = ZSOCK_POLLIN;
	/* Per-session ICPC state (CONTROL -> ACK + STATUS). */
	uint32_t zseq = 1;
	ssize_t n = -1;
	for (;;) {
		int poll_r = zsock_poll(&pfd, 1, 100);
		if (poll_r > 0 && (pfd.revents & ZSOCK_POLLIN)) {
			n = zsock_recvfrom(sock, buf, sizeof(buf), 0,
					     (struct sockaddr *)&from, &from_len);
			if (n < 0) {
				continue;
			}
			goto have_packet;
		}
		/* Poll timeout / error: run the 500 ms watchdog. */
		{
			int64_t now_ms = k_uptime_get();
			if (!plant.safe && now_ms - last_control_ms >= 500) {
				plant_enter_safe(&plant);
				printk("TGOS_ZEPHYR_SAFE|NETWORK_TIMEOUT "
				       "last_control_ms=%lld now_ms=%lld duty=%d\n",
				       (long long)last_control_ms, (long long)now_ms,
				       plant.duty_q16_16);
			}
			continue;
		}
	have_packet:
		;
		char peer[16];
		net_addr_ntop(AF_INET, &from.sin_addr, peer, sizeof(peer));
		if (strcmp(peer, PEER_IP) != 0) {
			continue;
		}
		/* Try ICPC: if the peer sent a valid CONTROL, reply with an ACK
		 * (+ STATUS) instead of a plain echo. */
		struct icpc_header rh;
		const uint8_t *rpay;
		size_t rlen = 0;
		if (icpc_decode((const uint8_t *)buf, (size_t)n, &rh, &rpay, &rlen) ==
			    ICPC_STATUS_OK &&
		    rh.message_type == ICPC_MESSAGE_CONTROL &&
		    rh.session_id != 0U) {
			/* P5-AI-Q: any valid new CONTROL (new session/seq) resumes the
			 * plant from the watchdog safe state and refreshes the timer. */
			last_control_ms = k_uptime_get();
			struct icpc_header ack;
			memset(&ack, 0, sizeof(ack));
			ack.message_type = ICPC_MESSAGE_ACK;
			ack.flags = 0;
			ack.session_id = rh.session_id;
			ack.sequence = zseq++;
			ack.ack_sequence = rh.sequence;
			ack.timestamp_ms = 0;
			ack.error_code = ICPC_ERROR_NONE;
			uint8_t ackbuf[ICPC_HEADER_SIZE + 4];
			size_t alen = 0;
			(void)rh.sequence;
			if (icpc_encode(ackbuf, sizeof(ackbuf), &ack, NULL, 0, &alen) ==
			    ICPC_STATUS_OK) {
				ssize_t ar = zsock_sendto(sock, ackbuf, alen, 0,
					   (struct sockaddr *)&from, from_len);
				if (ar < 0) {
					static int once;
					if (once < 5) { once++;
					    printk("TGOS_ZEPHYR_ACK_SEND_FAIL err=%d n=%zd rseq=%u\n",
						   errno, ar, rh.sequence);
					}
				}
			}
			struct icpc_header st;
			memset(&st, 0, sizeof(st));
			st.message_type = ICPC_MESSAGE_STATUS;
			st.flags = 0;
			st.session_id = rh.session_id;
			st.sequence = zseq++;
			st.ack_sequence = 0;
			st.timestamp_ms = (uint64_t)rh.timestamp_ms;
			st.error_code = ICPC_ERROR_NONE;
			/* P5-AI-B: apply the decoded CONTROL duty to the DEC-008 plant and
			 * report the real plant state in the 32-byte icpc_status_payload. */
			int32_t duty = 0;
			uint32_t req_id = 0;
			if (rlen >= 12) memcpy(&duty, rpay + 8, sizeof(duty));
			if (rlen >= 8) memcpy(&req_id, rpay + 4, sizeof(req_id));
			(void)plant_apply_duty(&plant, duty);
			struct plant_step_result spr = plant_step(&plant);
			if (spr.status != PLANT_STATUS_OK) {
				plant_enter_safe(&plant);
			}
			uint8_t stpay[32];
			memset(stpay, 0, sizeof(stpay));
			stpay[0] = 1; /* schema_version */
			stpay[1] = 1; /* control_mode = MLP */
			memcpy(stpay + 4, &req_id, 4);   /* applied_request_id */
			uint64_t sample = plant.tick_index;
			memcpy(stpay + 8, &sample, 8);   /* sample_index */
			int32_t measured = plant.temperature_mC;
			int32_t target = PLANT_TARGET_TEMPERATURE_MC;
			int32_t cerr = target - (int32_t)plant.temperature_mC;
			memcpy(stpay + 16, &measured, 4);
			memcpy(stpay + 20, &target, 4);
			memcpy(stpay + 24, &plant.duty_q16_16, 4);
			memcpy(stpay + 28, &cerr, 4);
			uint8_t stbuf[ICPC_HEADER_SIZE + 32];
			size_t slen = 0;
			if (icpc_encode(stbuf, sizeof(stbuf), &st, stpay, sizeof(stpay),
					 &slen) == ICPC_STATUS_OK) {
				(void)zsock_sendto(sock, stbuf, slen, 0,
					   (struct sockaddr *)&from, from_len);
			}
			(void)rh.sequence; /* per-CONTROL printk removed: console slows replies */
			continue;
		}
		/* Non-CONTROL ICPC frames (ACK/STATUS echoed by the peer) must NOT be
		 * echoed back: that would create an unbounded echo loop between the
		 * two guests and keep the poll busy, starving the watchdog.
		 * Everything else (probe, plain UDP) is echoed as before. */
		{
			struct icpc_header rh2;
			const uint8_t *rpay2;
			size_t rlen2 = 0;
			if (icpc_decode((const uint8_t *)buf, (size_t)n, &rh2, &rpay2,
					 &rlen2) == ICPC_STATUS_OK) {
				continue;
			}
		}
		(void)zsock_sendto(sock, buf, n, 0, (struct sockaddr *)&from, from_len);
		printk("TGOS_ZEPHYR_UDP_ECHO peer=%s bytes=%zd\n", peer, n);
	}
}

static int tcp_listen_thread(void)
{
	struct sockaddr_in local;
	struct sockaddr_in from;
	socklen_t from_len = sizeof(from);
	char buf[2048];
	int lsock = zsock_socket(AF_INET, SOCK_STREAM, IPPROTO_TCP);

	if (lsock < 0) {
		printk("TGOS_ZEPHYR_NET_FAIL tcp sock\n");
		return -1;
	}
	int one = 1;
	(void)zsock_setsockopt(lsock, SOL_SOCKET, SO_REUSEADDR, &one, sizeof(one));
	memset(&local, 0, sizeof(local));
	local.sin_family = AF_INET;
	local.sin_port = htons(TCP_PORT);
	if (zsock_bind(lsock, (struct sockaddr *)&local, sizeof(local)) < 0 ||
	    zsock_listen(lsock, 1) < 0) {
		printk("TGOS_ZEPHYR_NET_FAIL tcp bind/listen\n");
		return -1;
	}
	printk("TGOS_ZEPHYR_TCP_LISTEN_READY port=%d\n", TCP_PORT);
	for (;;) {
		int sock = zsock_accept(lsock, (struct sockaddr *)&from, &from_len);
		if (sock < 0) {
			continue;
		}
		printk("TGOS_ZEPHYR_TCP_ACCEPTED\n");
		for (;;) {
			ssize_t n = zsock_recv(sock, buf, sizeof(buf), 0);
			if (n <= 0) {
				break;
			}
			if (zsock_send(sock, buf, n, 0) < 0) {
				break;
			}
		}
		zsock_close(sock);
	}
}

int main(void)
{
	const char *mode = CONFIG_CONTEST_NET_MODE;

	k_sleep(K_MSEC(250));
	print_ready();

	if (strcmp(mode, "udp-echo") == 0) {
		return udp_echo_thread();
	}
	if (strcmp(mode, "tcp-listen") == 0) {
		return tcp_listen_thread();
	}
	/* l3-smoke: verify the interface is up and report the identity;
	 * ICMP echo and ICPC are exercised by the runner over UDP/TCP. */
	printk("TGOS_ZEPHYR_L3_SMOKE_READY\n");
	for (;;) {
		k_sleep(K_SECONDS(5));
	}
	return 0;
}
```

## include/control_mailbox.h
```c
#ifndef CONTEST_ZEPHYR_CONTROL_MAILBOX_H
#define CONTEST_ZEPHYR_CONTROL_MAILBOX_H

#include <stdint.h>

#ifdef __cplusplus
extern "C" {
#endif

#define CONTROL_MAILBOX_SCHEMA_VERSION UINT8_C(1)
#define CONTROL_MAILBOX_VALIDITY_MS UINT16_C(500)
#define CONTROL_MAILBOX_TARGET_MC INT32_C(55000)
#define CONTROL_MAILBOX_MIN_DUTY_Q16_16 INT32_C(0)
#define CONTROL_MAILBOX_MAX_DUTY_Q16_16 INT32_C(65536)

enum control_mailbox_command_type {
    CONTROL_MAILBOX_APPLY_OUTPUT = 1,
    CONTROL_MAILBOX_ENTER_SAFE = 2,
    CONTROL_MAILBOX_SET_TARGET = 3,
};

enum control_mailbox_mode {
    CONTROL_MAILBOX_FIXED_BASELINE = 0,
    CONTROL_MAILBOX_MLP = 1,
};

enum control_mailbox_status {
    CONTROL_MAILBOX_STATUS_OK = 0,
    CONTROL_MAILBOX_STATUS_EMPTY,
    CONTROL_MAILBOX_STATUS_NULL_ARGUMENT,
    CONTROL_MAILBOX_STATUS_INVALID_SESSION,
    CONTROL_MAILBOX_STATUS_SESSION_MISMATCH,
    CONTROL_MAILBOX_STATUS_SESSION_NOT_NEW,
    CONTROL_MAILBOX_STATUS_INVALID_SEQUENCE,
    CONTROL_MAILBOX_STATUS_INVALID_REQUEST,
    CONTROL_MAILBOX_STATUS_INVALID_COMMAND,
    CONTROL_MAILBOX_STATUS_INVALID_MODE,
    CONTROL_MAILBOX_STATUS_INVALID_DUTY,
    CONTROL_MAILBOX_STATUS_INVALID_TARGET,
    CONTROL_MAILBOX_STATUS_INVALID_MODEL_VERSION,
    CONTROL_MAILBOX_STATUS_INVALID_VALIDITY,
    CONTROL_MAILBOX_STATUS_DUPLICATE,
    CONTROL_MAILBOX_STATUS_STALE_SEQUENCE,
    CONTROL_MAILBOX_STATUS_STALE_REQUEST,
    CONTROL_MAILBOX_STATUS_AMBIGUOUS_ORDER,
};

struct control_mailbox_command {
    uint32_t session_id;
    uint32_t sequence;
    uint32_t request_id;
    uint8_t command;
    uint8_t control_mode;
    int32_t duty_q16_16;
    int32_t target_mC;
    uint32_t model_version;
    uint16_t validity_ms;
};

struct control_mailbox {
    struct control_mailbox_command pending;
    uint32_t active_session_id;
    uint32_t previous_session_id;
    uint32_t last_sequence;
    uint32_t last_request_id;
    uint8_t has_pending;
    uint8_t has_session;
    uint8_t has_previous_session;
    uint8_t has_order;
};

/**
 * Initialize an empty, safe mailbox with no active session.
 */
void control_mailbox_init(struct control_mailbox *mailbox);

/**
 * Install a locally-created session and discard all pending commands from the
 * previous session. A session ID cannot be zero, repeated, or the immediately
 * previous session ID.
 */
enum control_mailbox_status
control_mailbox_begin_session(struct control_mailbox *mailbox,
                              uint32_t session_id);

/**
 * Validate and publish one command into the capacity-one latest-valid slot.
 *
 * The caller owns any transport parsing and must serialize calls to this
 * portable reference. A newer valid command replaces an unconsumed command;
 * stale and duplicate identities never replace it.
 */
enum control_mailbox_status
control_mailbox_publish(struct control_mailbox *mailbox,
                        const struct control_mailbox_command *command);

/**
 * Consume the newest pending command exactly once.
 */
enum control_mailbox_status
control_mailbox_take(struct control_mailbox *mailbox,
                     struct control_mailbox_command *command);

/**
 * Return non-zero when a command is waiting to be consumed. Null is treated
 * as empty for fail-closed polling.
 */
uint8_t control_mailbox_has_pending(const struct control_mailbox *mailbox);

#ifdef __cplusplus
}
#endif

#endif
```

## include/plant.h
```c
#ifndef CONTEST_ZEPHYR_CONTROL_PLANT_H
#define CONTEST_ZEPHYR_CONTROL_PLANT_H

#include <stdint.h>

#ifdef __cplusplus
extern "C" {
#endif

#define PLANT_TICK_PERIOD_MS UINT32_C(100)
#define PLANT_INITIAL_TEMPERATURE_MC INT32_C(25000)
#define PLANT_AMBIENT_TEMPERATURE_MC INT32_C(25000)
#define PLANT_TARGET_TEMPERATURE_MC INT32_C(55000)
#define PLANT_HEATER_RATE_MC_PER_SECOND INT32_C(4000)
#define PLANT_HEAT_LOSS_DIVISOR INT32_C(100)
#define PLANT_MIN_TEMPERATURE_MC INT32_C(-40000)
#define PLANT_MAX_TEMPERATURE_MC INT32_C(125000)
#define PLANT_DISTURBANCE_START_TICK UINT64_C(600)
#define PLANT_DISTURBANCE_END_TICK UINT64_C(899)
#define PLANT_DISTURBANCE_MC_PER_TICK INT32_C(-150)
#define PLANT_MIN_DUTY_Q16_16 INT32_C(0)
#define PLANT_MAX_DUTY_Q16_16 INT32_C(65536)

enum plant_status {
    PLANT_STATUS_OK = 0,
    PLANT_STATUS_NULL_ARGUMENT,
    PLANT_STATUS_INVALID_DUTY,
    PLANT_STATUS_RANGE_OVERFLOW,
    PLANT_STATUS_TICK_OVERFLOW,
    PLANT_STATUS_NONFINITE_PI,
};

struct plant_state {
    int32_t temperature_mC;
    uint64_t tick_index;
    int32_t duty_q16_16;
    uint8_t safe;
};

struct plant_step_result {
    enum plant_status status;
    int64_t candidate_temperature_mC;
    int32_t loss_mC;
    int32_t heater_mC;
    int32_t disturbance_mC;
};

struct plant_pi_controller {
    double integral_c_seconds;
};

/**
 * Reset a plant to the frozen qualification initial state.
 *
 * A null state is ignored so that a teardown path cannot turn a safety reset
 * into a host crash.
 */
void plant_reset(struct plant_state *state);

/**
 * Force the plant actuator to the safe value without changing temperature or
 * tick state.
 */
void plant_enter_safe(struct plant_state *state);

/**
 * Apply one validated duty at a period boundary.
 *
 * Invalid duty values fail closed by forcing duty zero and safe state. The
 * plant temperature and tick are not changed by a rejected duty.
 */
enum plant_status plant_apply_duty(struct plant_state *state,
                                   int32_t duty_q16_16);

/**
 * Advance the plant by one 100 ms tick using the duty selected at the period
 * boundary.
 *
 * The result is committed only when it is in the inclusive mC range
 * [-40000, 125000]. An out-of-range result leaves temperature and tick
 * unchanged, then forces duty zero and safe state.
 */
struct plant_step_result plant_step(struct plant_state *state);

/**
 * Reset the fixed binary64 PI controller integral to zero.
 */
void plant_pi_reset(struct plant_pi_controller *controller);

/**
 * Compute one fixed PI Q16.16 output using the frozen anti-windup rule.
 *
 * The controller uses the expression order from the P5 contract and rounds
 * non-negative output with floor(u * 65536 + 0.5).
 */
enum plant_status plant_pi_update(struct plant_pi_controller *controller,
                                  int32_t measured_mC, int32_t target_mC,
                                  int32_t *duty_q16_16);

#ifdef __cplusplus
}
#endif

#endif
```

## include/watchdog.h
```c
#ifndef CONTEST_ZEPHYR_CONTROL_WATCHDOG_H
#define CONTEST_ZEPHYR_CONTROL_WATCHDOG_H

#include <stdint.h>

#ifdef __cplusplus
extern "C" {
#endif

#define WATCHDOG_VALIDITY_MS UINT16_C(500)
#define WATCHDOG_TIMEOUT_MS UINT64_C(500)
#define WATCHDOG_TIMEOUT_NS UINT64_C(500000000)

enum watchdog_status {
    WATCHDOG_STATUS_ALIVE = 0,
    WATCHDOG_STATUS_SAFE,
    WATCHDOG_STATUS_EXPIRED,
    WATCHDOG_STATUS_NULL_ARGUMENT,
    WATCHDOG_STATUS_INVALID_SESSION,
    WATCHDOG_STATUS_NO_SESSION,
    WATCHDOG_STATUS_SESSION_MISMATCH,
    WATCHDOG_STATUS_SESSION_NOT_NEW,
    WATCHDOG_STATUS_INVALID_SEQUENCE,
    WATCHDOG_STATUS_INVALID_REQUEST,
    WATCHDOG_STATUS_INVALID_VALIDITY,
    WATCHDOG_STATUS_DUPLICATE,
    WATCHDOG_STATUS_STALE_SEQUENCE,
    WATCHDOG_STATUS_STALE_REQUEST,
    WATCHDOG_STATUS_AMBIGUOUS_ORDER,
    WATCHDOG_STATUS_RECOVERY_REQUIRES_SESSION,
    WATCHDOG_STATUS_CLOCK_BACKWARD,
};

struct watchdog {
    uint32_t active_session_id;
    uint32_t previous_session_id;
    uint32_t last_sequence;
    uint32_t last_request_id;
    uint64_t session_start_ns;
    uint64_t last_apply_ns;
    uint64_t last_observed_ns;
    uint8_t has_session;
    uint8_t has_previous_session;
    uint8_t has_apply;
    uint8_t has_observed_time;
    uint8_t safe_pending;
    uint8_t requires_new_session;
};

/**
 * Initialize a watchdog in safe state with no active session or valid output.
 */
void watchdog_init(struct watchdog *watchdog);

/**
 * Begin a locally-created session at a receiver monotonic timestamp.
 *
 * A new session starts safe and has no valid output deadline. The old session
 * cannot refresh this watchdog after the switch.
 */
enum watchdog_status watchdog_begin_session(struct watchdog *watchdog,
                                            uint32_t session_id,
                                            uint64_t now_ns);

/**
 * Accept one new, valid APPLY_OUTPUT and refresh the local 500 ms deadline.
 *
 * The timestamp is receiver-local monotonic time. Invalid validity, duplicate
 * identity, stale identity, wrong session, and backwards time do not refresh.
 */
enum watchdog_status watchdog_refresh_apply(struct watchdog *watchdog,
                                            uint32_t session_id,
                                            uint32_t sequence,
                                            uint32_t request_id,
                                            uint16_t validity_ms,
                                            uint64_t now_ns);

/**
 * Poll the watchdog at a local monotonic timestamp.
 *
 * Exactly 500 ms is expired. Once pending-safe, the state remains safe until
 * a newer valid APPLY_OUTPUT is accepted.
 */
enum watchdog_status watchdog_poll(struct watchdog *watchdog,
                                   uint64_t now_ns);

/**
 * Query the fail-closed pending-safe state. Null is considered safe.
 */
uint8_t watchdog_safe_pending(const struct watchdog *watchdog);

#ifdef __cplusplus
}
#endif

#endif
```

## src/control_mailbox.c
```c
#include <stddef.h>
#include "control_mailbox.h"

enum mailbox_order {
    MAILBOX_ORDER_OLDER = -1,
    MAILBOX_ORDER_SAME = 0,
    MAILBOX_ORDER_NEWER = 1,
    MAILBOX_ORDER_AMBIGUOUS = 2,
};

static enum control_mailbox_status validate_command(
    const struct control_mailbox_command *command);
static enum mailbox_order compare_sequence(uint32_t candidate,
                                            uint32_t current);
static enum control_mailbox_status compare_command_identity(
    const struct control_mailbox *mailbox,
    const struct control_mailbox_command *command);

void control_mailbox_init(struct control_mailbox *mailbox)
{
    if (mailbox == NULL) {
        return;
    }

    *mailbox = (struct control_mailbox){0};
}

enum control_mailbox_status
control_mailbox_begin_session(struct control_mailbox *mailbox,
                              uint32_t session_id)
{
    if (mailbox == NULL) {
        return CONTROL_MAILBOX_STATUS_NULL_ARGUMENT;
    }
    if (session_id == 0U) {
        return CONTROL_MAILBOX_STATUS_INVALID_SESSION;
    }
    if (mailbox->has_session && mailbox->active_session_id == session_id) {
        return CONTROL_MAILBOX_STATUS_SESSION_NOT_NEW;
    }
    if (mailbox->has_previous_session &&
        mailbox->previous_session_id == session_id) {
        return CONTROL_MAILBOX_STATUS_SESSION_NOT_NEW;
    }

    if (mailbox->has_session) {
        mailbox->previous_session_id = mailbox->active_session_id;
        mailbox->has_previous_session = UINT8_C(1);
    }
    mailbox->active_session_id = session_id;
    mailbox->has_session = UINT8_C(1);
    mailbox->has_order = UINT8_C(0);
    mailbox->has_pending = UINT8_C(0);
    mailbox->pending = (struct control_mailbox_command){0};
    mailbox->last_sequence = 0U;
    mailbox->last_request_id = 0U;
    return CONTROL_MAILBOX_STATUS_OK;
}

enum control_mailbox_status
control_mailbox_publish(struct control_mailbox *mailbox,
                        const struct control_mailbox_command *command)
{
    enum control_mailbox_status status;

    if (mailbox == NULL || command == NULL) {
        return CONTROL_MAILBOX_STATUS_NULL_ARGUMENT;
    }
    if (command->session_id == 0U) {
        return CONTROL_MAILBOX_STATUS_INVALID_SESSION;
    }
    if (!mailbox->has_session ||
        command->session_id != mailbox->active_session_id) {
        return CONTROL_MAILBOX_STATUS_SESSION_MISMATCH;
    }

    status = validate_command(command);
    if (status != CONTROL_MAILBOX_STATUS_OK) {
        return status;
    }
    if (mailbox->has_order) {
        status = compare_command_identity(mailbox, command);
        if (status != CONTROL_MAILBOX_STATUS_OK) {
            return status;
        }
    }

    mailbox->pending = *command;
    mailbox->has_pending = UINT8_C(1);
    mailbox->last_sequence = command->sequence;
    mailbox->last_request_id = command->request_id;
    mailbox->has_order = UINT8_C(1);
    return CONTROL_MAILBOX_STATUS_OK;
}

enum control_mailbox_status
control_mailbox_take(struct control_mailbox *mailbox,
                     struct control_mailbox_command *command)
{
    if (mailbox == NULL || command == NULL) {
        return CONTROL_MAILBOX_STATUS_NULL_ARGUMENT;
    }
    if (!mailbox->has_pending) {
        return CONTROL_MAILBOX_STATUS_EMPTY;
    }

    *command = mailbox->pending;
    mailbox->pending = (struct control_mailbox_command){0};
    mailbox->has_pending = UINT8_C(0);
    return CONTROL_MAILBOX_STATUS_OK;
}

uint8_t control_mailbox_has_pending(const struct control_mailbox *mailbox)
{
    if (mailbox == NULL) {
        return UINT8_C(0);
    }
    return mailbox->has_pending;
}

static enum control_mailbox_status validate_command(
    const struct control_mailbox_command *command)
{
    if (command->sequence == 0U) {
        return CONTROL_MAILBOX_STATUS_INVALID_SEQUENCE;
    }
    if (command->request_id == 0U) {
        return CONTROL_MAILBOX_STATUS_INVALID_REQUEST;
    }
    if (command->command < CONTROL_MAILBOX_APPLY_OUTPUT ||
        command->command > CONTROL_MAILBOX_SET_TARGET) {
        return CONTROL_MAILBOX_STATUS_INVALID_COMMAND;
    }
    if (command->control_mode > CONTROL_MAILBOX_MLP) {
        return CONTROL_MAILBOX_STATUS_INVALID_MODE;
    }
    if (command->target_mC != CONTROL_MAILBOX_TARGET_MC) {
        return CONTROL_MAILBOX_STATUS_INVALID_TARGET;
    }
    if (command->validity_ms != CONTROL_MAILBOX_VALIDITY_MS) {
        return CONTROL_MAILBOX_STATUS_INVALID_VALIDITY;
    }

    if (command->command == CONTROL_MAILBOX_APPLY_OUTPUT) {
        if (command->duty_q16_16 < CONTROL_MAILBOX_MIN_DUTY_Q16_16 ||
            command->duty_q16_16 > CONTROL_MAILBOX_MAX_DUTY_Q16_16) {
            return CONTROL_MAILBOX_STATUS_INVALID_DUTY;
        }
        if (command->control_mode == CONTROL_MAILBOX_MLP) {
            if (command->model_version == 0U) {
                return CONTROL_MAILBOX_STATUS_INVALID_MODEL_VERSION;
            }
        } else if (command->model_version != 0U) {
            return CONTROL_MAILBOX_STATUS_INVALID_MODEL_VERSION;
        }
        return CONTROL_MAILBOX_STATUS_OK;
    }

    if (command->duty_q16_16 != 0 || command->model_version != 0U) {
        return CONTROL_MAILBOX_STATUS_INVALID_DUTY;
    }
    return CONTROL_MAILBOX_STATUS_OK;
}

static enum mailbox_order compare_sequence(uint32_t candidate,
                                            uint32_t current)
{
    const uint32_t difference = candidate - current;

    if (difference == 0U) {
        return MAILBOX_ORDER_SAME;
    }
    if (difference == UINT32_C(0x80000000)) {
        return MAILBOX_ORDER_AMBIGUOUS;
    }
    if (difference < UINT32_C(0x80000000)) {
        return MAILBOX_ORDER_NEWER;
    }
    return MAILBOX_ORDER_OLDER;
}

static enum control_mailbox_status compare_command_identity(
    const struct control_mailbox *mailbox,
    const struct control_mailbox_command *command)
{
    const enum mailbox_order sequence_order =
        compare_sequence(command->sequence, mailbox->last_sequence);
    const enum mailbox_order request_order =
        compare_sequence(command->request_id, mailbox->last_request_id);

    if (sequence_order == MAILBOX_ORDER_AMBIGUOUS ||
        request_order == MAILBOX_ORDER_AMBIGUOUS) {
        return CONTROL_MAILBOX_STATUS_AMBIGUOUS_ORDER;
    }
    if (sequence_order == MAILBOX_ORDER_SAME &&
        request_order == MAILBOX_ORDER_SAME) {
        return CONTROL_MAILBOX_STATUS_DUPLICATE;
    }
    if (sequence_order != MAILBOX_ORDER_NEWER) {
        return CONTROL_MAILBOX_STATUS_STALE_SEQUENCE;
    }
    if (request_order != MAILBOX_ORDER_NEWER) {
        return CONTROL_MAILBOX_STATUS_STALE_REQUEST;
    }
    return CONTROL_MAILBOX_STATUS_OK;
}
```

## src/plant.c
```c
#include <stddef.h>
#include "plant.h"

#include <math.h>

static int valid_duty(int32_t duty_q16_16);
static int64_t plant_loss(int32_t temperature_mC);
static int64_t plant_heater(int32_t duty_q16_16);
static int64_t plant_disturbance(uint64_t tick_index);
static double clamp_integral(double integral_c_seconds);
static double fixed_pi_output(double error_c, double integral_c_seconds);
static int32_t quantize_pi_output(double output);

void plant_reset(struct plant_state *state)
{
    if (state == NULL) {
        return;
    }

    state->temperature_mC = PLANT_INITIAL_TEMPERATURE_MC;
    state->tick_index = 0U;
    state->duty_q16_16 = PLANT_MIN_DUTY_Q16_16;
    state->safe = UINT8_C(1);
}

void plant_enter_safe(struct plant_state *state)
{
    if (state == NULL) {
        return;
    }

    state->duty_q16_16 = PLANT_MIN_DUTY_Q16_16;
    state->safe = UINT8_C(1);
}

enum plant_status plant_apply_duty(struct plant_state *state,
                                   int32_t duty_q16_16)
{
    if (state == NULL) {
        return PLANT_STATUS_NULL_ARGUMENT;
    }
    if (!valid_duty(duty_q16_16)) {
        plant_enter_safe(state);
        return PLANT_STATUS_INVALID_DUTY;
    }

    state->duty_q16_16 = duty_q16_16;
    state->safe = UINT8_C(0);
    return PLANT_STATUS_OK;
}

struct plant_step_result plant_step(struct plant_state *state)
{
    struct plant_step_result result = {
        .status = PLANT_STATUS_OK,
        .candidate_temperature_mC = 0,
        .loss_mC = 0,
        .heater_mC = 0,
        .disturbance_mC = 0,
    };
    int64_t next_temperature_mC;

    if (state == NULL) {
        result.status = PLANT_STATUS_NULL_ARGUMENT;
        return result;
    }
    if (!valid_duty(state->duty_q16_16)) {
        plant_enter_safe(state);
        result.status = PLANT_STATUS_INVALID_DUTY;
        return result;
    }
    if (state->temperature_mC < PLANT_MIN_TEMPERATURE_MC ||
        state->temperature_mC > PLANT_MAX_TEMPERATURE_MC) {
        plant_enter_safe(state);
        result.status = PLANT_STATUS_RANGE_OVERFLOW;
        result.candidate_temperature_mC = state->temperature_mC;
        return result;
    }
    if (state->tick_index == UINT64_MAX) {
        plant_enter_safe(state);
        result.status = PLANT_STATUS_TICK_OVERFLOW;
        result.candidate_temperature_mC = state->temperature_mC;
        return result;
    }

    /* C99 signed division deliberately supplies truncation toward zero. */
    result.loss_mC = (int32_t)plant_loss(state->temperature_mC);
    result.heater_mC = (int32_t)plant_heater(state->duty_q16_16);
    result.disturbance_mC = (int32_t)plant_disturbance(state->tick_index);
    next_temperature_mC = (int64_t)state->temperature_mC +
                          (int64_t)result.loss_mC +
                          (int64_t)result.heater_mC +
                          (int64_t)result.disturbance_mC;
    result.candidate_temperature_mC = next_temperature_mC;

    if (next_temperature_mC < PLANT_MIN_TEMPERATURE_MC ||
        next_temperature_mC > PLANT_MAX_TEMPERATURE_MC) {
        plant_enter_safe(state);
        result.status = PLANT_STATUS_RANGE_OVERFLOW;
        return result;
    }

    state->temperature_mC = (int32_t)next_temperature_mC;
    state->tick_index += UINT64_C(1);
    return result;
}

void plant_pi_reset(struct plant_pi_controller *controller)
{
    if (controller == NULL) {
        return;
    }

    controller->integral_c_seconds = 0.0;
}

enum plant_status plant_pi_update(struct plant_pi_controller *controller,
                                  int32_t measured_mC, int32_t target_mC,
                                  int32_t *duty_q16_16)
{
    double error_c;
    double previous_integral;
    double candidate_integral;
    double candidate_output;
    double output;

    if (controller == NULL || duty_q16_16 == NULL) {
        return PLANT_STATUS_NULL_ARGUMENT;
    }

    previous_integral = controller->integral_c_seconds;
    if (!isfinite(previous_integral)) {
        return PLANT_STATUS_NONFINITE_PI;
    }

    error_c = ((double)target_mC - (double)measured_mC) / 1000.0;
    candidate_integral = clamp_integral(previous_integral + 0.1 * error_c);
    candidate_output = fixed_pi_output(error_c, candidate_integral);

    if ((candidate_output > 1.0 && error_c > 0.0) ||
        (candidate_output < 0.0 && error_c < 0.0)) {
        controller->integral_c_seconds = previous_integral;
        output = fixed_pi_output(error_c, previous_integral);
    } else {
        controller->integral_c_seconds = candidate_integral;
        output = candidate_output;
    }

    if (!isfinite(output)) {
        return PLANT_STATUS_NONFINITE_PI;
    }
    if (output < 0.0) {
        output = 0.0;
    } else if (output > 1.0) {
        output = 1.0;
    }
    *duty_q16_16 = quantize_pi_output(output);
    return PLANT_STATUS_OK;
}

static int valid_duty(int32_t duty_q16_16)
{
    return duty_q16_16 >= PLANT_MIN_DUTY_Q16_16 &&
           duty_q16_16 <= PLANT_MAX_DUTY_Q16_16;
}

static int64_t plant_loss(int32_t temperature_mC)
{
    const int64_t numerator = (int64_t)PLANT_AMBIENT_TEMPERATURE_MC -
                              (int64_t)temperature_mC;

    return numerator / PLANT_HEAT_LOSS_DIVISOR;
}

static int64_t plant_heater(int32_t duty_q16_16)
{
    const int64_t numerator = (int64_t)PLANT_HEATER_RATE_MC_PER_SECOND / 10 *
                              (int64_t)duty_q16_16 +
                              INT64_C(32768);

    return numerator / INT64_C(65536);
}

static int64_t plant_disturbance(uint64_t tick_index)
{
    if (tick_index >= PLANT_DISTURBANCE_START_TICK &&
        tick_index <= PLANT_DISTURBANCE_END_TICK) {
        return PLANT_DISTURBANCE_MC_PER_TICK;
    }
    return 0;
}

static double clamp_integral(double integral_c_seconds)
{
    if (integral_c_seconds < -100.0) {
        return -100.0;
    }
    if (integral_c_seconds > 100.0) {
        return 100.0;
    }
    return integral_c_seconds;
}

static double fixed_pi_output(double error_c, double integral_c_seconds)
{
    const double proportional_term = 0.025 * error_c;
    const double integral_term = 0.005 * integral_c_seconds;

    return proportional_term + integral_term;
}

static int32_t quantize_pi_output(double output)
{
    if (output <= 0.0) {
        return PLANT_MIN_DUTY_Q16_16;
    }
    if (output >= 1.0) {
        return PLANT_MAX_DUTY_Q16_16;
    }
    return (int32_t)(output * 65536.0 + 0.5);
}
```

## src/watchdog.c
```c
#include <stddef.h>
#include "watchdog.h"

enum watchdog_order {
    WATCHDOG_ORDER_OLDER = -1,
    WATCHDOG_ORDER_SAME = 0,
    WATCHDOG_ORDER_NEWER = 1,
    WATCHDOG_ORDER_AMBIGUOUS = 2,
};

static enum watchdog_status observe_time(struct watchdog *watchdog,
                                         uint64_t now_ns);
static enum watchdog_order compare_sequence(uint32_t candidate,
                                             uint32_t current);
static enum watchdog_status compare_identity(const struct watchdog *watchdog,
                                             uint32_t sequence,
                                             uint32_t request_id);

void watchdog_init(struct watchdog *watchdog)
{
    if (watchdog == NULL) {
        return;
    }

    *watchdog = (struct watchdog){0};
    watchdog->safe_pending = UINT8_C(1);
}

enum watchdog_status watchdog_begin_session(struct watchdog *watchdog,
                                            uint32_t session_id,
                                            uint64_t now_ns)
{
    enum watchdog_status time_status;

    if (watchdog == NULL) {
        return WATCHDOG_STATUS_NULL_ARGUMENT;
    }
    if (session_id == 0U) {
        return WATCHDOG_STATUS_INVALID_SESSION;
    }
    time_status = observe_time(watchdog, now_ns);
    if (time_status != WATCHDOG_STATUS_ALIVE) {
        return time_status;
    }
    if (watchdog->has_session && watchdog->active_session_id == session_id) {
        return WATCHDOG_STATUS_SESSION_NOT_NEW;
    }
    if (watchdog->has_previous_session &&
        watchdog->previous_session_id == session_id) {
        return WATCHDOG_STATUS_SESSION_NOT_NEW;
    }

    if (watchdog->has_session) {
        watchdog->previous_session_id = watchdog->active_session_id;
        watchdog->has_previous_session = UINT8_C(1);
    }
    watchdog->active_session_id = session_id;
    watchdog->session_start_ns = now_ns;
    watchdog->last_apply_ns = 0U;
    watchdog->last_sequence = 0U;
    watchdog->last_request_id = 0U;
    watchdog->has_session = UINT8_C(1);
    watchdog->has_apply = UINT8_C(0);
    watchdog->safe_pending = UINT8_C(1);
    watchdog->requires_new_session = UINT8_C(0);
    return WATCHDOG_STATUS_ALIVE;
}

enum watchdog_status watchdog_refresh_apply(struct watchdog *watchdog,
                                            uint32_t session_id,
                                            uint32_t sequence,
                                            uint32_t request_id,
                                            uint16_t validity_ms,
                                            uint64_t now_ns)
{
    enum watchdog_status time_status;
    enum watchdog_status identity_status;

    if (watchdog == NULL) {
        return WATCHDOG_STATUS_NULL_ARGUMENT;
    }
    time_status = observe_time(watchdog, now_ns);
    if (time_status == WATCHDOG_STATUS_CLOCK_BACKWARD) {
        return time_status;
    }
    if (session_id == 0U) {
        return WATCHDOG_STATUS_INVALID_SESSION;
    }
    if (!watchdog->has_session) {
        return WATCHDOG_STATUS_NO_SESSION;
    }
    if (session_id != watchdog->active_session_id) {
        return WATCHDOG_STATUS_SESSION_MISMATCH;
    }
    if (sequence == 0U) {
        return WATCHDOG_STATUS_INVALID_SEQUENCE;
    }
    if (request_id == 0U) {
        return WATCHDOG_STATUS_INVALID_REQUEST;
    }
    if (validity_ms != WATCHDOG_VALIDITY_MS) {
        return WATCHDOG_STATUS_INVALID_VALIDITY;
    }
    if (watchdog->requires_new_session) {
        return WATCHDOG_STATUS_RECOVERY_REQUIRES_SESSION;
    }
    if (watchdog->has_apply) {
        identity_status = compare_identity(watchdog, sequence, request_id);
        if (identity_status != WATCHDOG_STATUS_ALIVE) {
            return identity_status;
        }
    }

    watchdog->last_sequence = sequence;
    watchdog->last_request_id = request_id;
    watchdog->last_apply_ns = now_ns;
    watchdog->has_apply = UINT8_C(1);
    watchdog->safe_pending = UINT8_C(0);
    watchdog->requires_new_session = UINT8_C(0);
    return WATCHDOG_STATUS_ALIVE;
}

enum watchdog_status watchdog_poll(struct watchdog *watchdog,
                                   uint64_t now_ns)
{
    enum watchdog_status time_status;

    if (watchdog == NULL) {
        return WATCHDOG_STATUS_NULL_ARGUMENT;
    }
    time_status = observe_time(watchdog, now_ns);
    if (time_status == WATCHDOG_STATUS_CLOCK_BACKWARD) {
        watchdog->safe_pending = UINT8_C(1);
        return time_status;
    }
    if (!watchdog->has_session || !watchdog->has_apply) {
        watchdog->safe_pending = UINT8_C(1);
        return WATCHDOG_STATUS_SAFE;
    }
    if (watchdog->safe_pending) {
        return WATCHDOG_STATUS_EXPIRED;
    }
    if (now_ns - watchdog->last_apply_ns >= WATCHDOG_TIMEOUT_NS) {
        watchdog->safe_pending = UINT8_C(1);
        watchdog->requires_new_session = UINT8_C(1);
        return WATCHDOG_STATUS_EXPIRED;
    }
    return WATCHDOG_STATUS_ALIVE;
}

uint8_t watchdog_safe_pending(const struct watchdog *watchdog)
{
    if (watchdog == NULL) {
        return UINT8_C(1);
    }
    return watchdog->safe_pending;
}

static enum watchdog_status observe_time(struct watchdog *watchdog,
                                         uint64_t now_ns)
{
    if (watchdog->has_observed_time && now_ns < watchdog->last_observed_ns) {
        watchdog->safe_pending = UINT8_C(1);
        if (watchdog->has_apply) {
            watchdog->requires_new_session = UINT8_C(1);
        }
        return WATCHDOG_STATUS_CLOCK_BACKWARD;
    }

    watchdog->last_observed_ns = now_ns;
    watchdog->has_observed_time = UINT8_C(1);
    return WATCHDOG_STATUS_ALIVE;
}

static enum watchdog_order compare_sequence(uint32_t candidate,
                                             uint32_t current)
{
    const uint32_t difference = candidate - current;

    if (difference == 0U) {
        return WATCHDOG_ORDER_SAME;
    }
    if (difference == UINT32_C(0x80000000)) {
        return WATCHDOG_ORDER_AMBIGUOUS;
    }
    if (difference < UINT32_C(0x80000000)) {
        return WATCHDOG_ORDER_NEWER;
    }
    return WATCHDOG_ORDER_OLDER;
}

static enum watchdog_status compare_identity(const struct watchdog *watchdog,
                                             uint32_t sequence,
                                             uint32_t request_id)
{
    const enum watchdog_order sequence_order =
        compare_sequence(sequence, watchdog->last_sequence);
    const enum watchdog_order request_order =
        compare_sequence(request_id, watchdog->last_request_id);

    if (sequence_order == WATCHDOG_ORDER_AMBIGUOUS ||
        request_order == WATCHDOG_ORDER_AMBIGUOUS) {
        return WATCHDOG_STATUS_AMBIGUOUS_ORDER;
    }
    if (sequence_order == WATCHDOG_ORDER_SAME &&
        request_order == WATCHDOG_ORDER_SAME) {
        return WATCHDOG_STATUS_DUPLICATE;
    }
    if (sequence_order != WATCHDOG_ORDER_NEWER) {
        return WATCHDOG_STATUS_STALE_SEQUENCE;
    }
    if (request_order != WATCHDOG_ORDER_NEWER) {
        return WATCHDOG_STATUS_STALE_REQUEST;
    }
    return WATCHDOG_STATUS_ALIVE;
}
```
