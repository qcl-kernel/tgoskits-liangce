/*
 * Template only: apply this to the locked Zephyr qemu_cortex_a53 revision and
 * validate the resulting zephyr.dts before using the image as evidence.
 */

/ {
    chosen {
        zephyr,console = &uart0;
        /delete-property/ zephyr,shell-uart;
        stdout-path = "/soc/uart@9000000";
    };
};

&uart0 {
    compatible = "arm,pl011";
    reg = <0x0 0x09000000 0x0 0x1000>;
    current-speed = <115200>;
    status = "okay";

    /delete-property/ interrupts;
    /delete-property/ interrupt-names;
    /delete-property/ interrupts-extended;
    /delete-property/ dmas;
    /delete-property/ dma-names;
};
